## base_external/Config.in
```kconfig
source "$BR2_EXTERNAL_project_base_PATH/package/final-application/Config.in"
source "$BR2_EXTERNAL_project_base_PATH/package/final-driver/Config.in"
source "$BR2_EXTERNAL_project_base_PATH/package/lwip/Config.in"
```

## base_external/package/final-application/Config.in
```kconfig
config BR2_PACKAGE_FINAL_APPLICATION
	bool "final-source-lwip-app"
	help
	  Includes the module for the AESD final project source code
```

## base_external/package/final-driver/Config.in
```kconfig
config BR2_PACKAGE_FINAL_DRIVER
	bool "final-source-custom-eth-driver"
	help
	  Includes the module for the AESD final project source code
```

## base_external/package/lwip/Config.in
```kconfig
config BR2_PACKAGE_LWIP
	bool "lwip"
	help
	  Includes the module for lwIP (Lightweight IP)
```
